## main/Kconfig.projbuild
```kconfig
# Criado por Eraldo Bispo — configuracao de WiFi, broker MQTT e login do painel web
# via idf.py menuconfig. Os valores abaixo sao usados apenas na primeira vez que o
# ESP liga (depois disso o painel web em config_server_kincony.c grava tudo na NVS).

menu "Kincony Configuration"

    config KINCONY_WIFI_SSID
        string "WiFi SSID"
        default "Dipelnet_Daniel_2.4GHz"
        help
            Nome da rede WiFi que o ESP32 vai conectar.

    config KINCONY_WIFI_PASSWORD
        string "WiFi Password"
        default "apto0104"
        help
            Senha da rede WiFi informada acima.

    config KINCONY_MQTT_BROKER_URI
        string "MQTT Broker URI"
        default "mqtts://453e5f32c60a48529669859610ab6a88.s1.eu.hivemq.cloud:8883"
        help
            Endereco do broker MQTT.
            Exemplo sem TLS: mqtt://test.mosquitto.org:1883
            Exemplo com TLS: mqtts://meu-broker.hivemq.cloud:8883

    # Editado por Eraldo Bispo — credenciais do broker MQTT, agora editaveis pelo painel web.
    # Defaults iguais aos que estavam fixos no codigo antes, para nao mudar o comportamento atual.
    config KINCONY_MQTT_USER
        string "Usuario do broker MQTT (opcional)"
        default "administrador"
        help
            Usuario para autenticacao no broker MQTT. Deixe vazio se o broker
            nao exigir autenticacao.

    config KINCONY_MQTT_PASSWORD
        string "Senha do broker MQTT (opcional)"
        default "Administrador2026"
        help
            Senha para autenticacao no broker MQTT. Deixe vazio se o broker
            nao exigir autenticacao.

    config KINCONY_HTTP_USER
        string "Usuario do painel de configuracao (HTTP)"
        default "aquapulse"
        help
            Usuario exigido para acessar a pagina web de configuracao do ESP.

    config KINCONY_HTTP_PASSWORD
        string "Senha do painel de configuracao (HTTP)"
        default "aquapulse2026"
        help
            Senha exigida para acessar a pagina web de configuracao do ESP.

    # Criado por Eraldo Bispo - 24/06/2026 - data/hora via NTP (sem RTC com bateria na placa,
    # nao ha o que configurar manualmente - se perderia a cada reboot). Editavel pelo painel
    # web (pagina /configuracoes) - estes valores so valem na primeira vez que o ESP liga.
    config KINCONY_NTP_SERVIDOR
        string "Servidor NTP"
        default "pool.ntp.org"
        help
            Servidor usado para sincronizar a data/hora pela internet.

    config KINCONY_NTP_FUSO_HORAS
        int "Fuso horario (horas em relacao a UTC)"
        default -3
        range -12 14
        help
            Fuso horario local. Brasil (Brasilia) = -3. Sem horario de verao
            (abolido no Brasil desde 2019).

    # Criado por Eraldo Bispo - 11/07/2026 - intervalo de publicacao MQTT configuravel pelo
    # painel web sem reinicializar. Editavel em /configuracoes (campo "Intervalo de Atualizacao MQTT").
    config KINCONY_MQTT_INTERVALO_S
        int "Intervalo de publicacao MQTT (segundos)"
        default 5
        range 1 180
        help
            Tempo entre publicacoes automaticas no broker MQTT.
            Pode ser alterado pelo painel web sem reiniciar o controlador.

endmenu
```

## sdkconfig.defaults
```kconfig
# Criado por Eraldo Bispo — garante que o build use o partitions.csv do projeto (OTA com
# 2 slots de 1800K) em vez da tabela padrao de fabrica (so 1 app de 1MB), que ficou pequena
# demais depois de adicionar MQTT, cJSON, servidor HTTP e a logo embutida (painel de WiFi).
CONFIG_PARTITION_TABLE_CUSTOM=y
CONFIG_PARTITION_TABLE_CUSTOM_FILENAME="partitions.csv"
CONFIG_PARTITION_TABLE_FILENAME="partitions.csv"

# Editado por Eraldo Bispo — o esquema OTA acima (2x1800K) exige mais de 2MB de flash, que e
# o padrao do IDF. Usei 4MB porque foi o que confirmamos via "esptool flash_id" na mesma
# familia de placa Kincony ESP32 usada neste projeto. Daniel: confirme com "esptool flash_id"
# na sua placa especifica; se for diferente, ajuste aqui ou em "idf.py menuconfig".
CONFIG_ESPTOOLPY_FLASHSIZE_4MB=y
CONFIG_ESPTOOLPY_FLASHSIZE="4MB"

# Criado por Eraldo Bispo — ota_github.c roda HTTPS/TLS direto na task "main", que estava com so
# 3584 bytes de pilha (padrao do IDF) e estourava (vApplicationStackOverflowHook -> reboot)
# durante o handshake TLS. O OTA foi movido para task propria, mas mantive uma margem extra aqui
# tambem para o resto que roda na main (entradas, logica, MQTT processar).
CONFIG_ESP_MAIN_TASK_STACK_SIZE=10240
```
